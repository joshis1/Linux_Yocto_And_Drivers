## resources/Yocto/Zynq/custom_yocto/meta-custom-zynq/conf/layer.conf
```bitbake
# We have a conf and classes directory, add to BBPATH
BBPATH .= ":${LAYERDIR}"

# We have a packages directory, add to BBFILES
BBFILES += "${LAYERDIR}/recipes-*/*/*.bb"
BBFILES += "${LAYERDIR}/recipes-*/*/*.bbappend"

BBFILE_COLLECTIONS += "kush"
BBFILE_PATTERN_kush = "^${LAYERDIR}/"
BBFILE_PRIORITY_kush = "6"

LAYERDEPENDS_kush = "core"

LAYERSERIES_COMPAT_kush = "warrior"

BB_DANGLINGAPPENDS_WARNONLY ?= "1"
```

## resources/Yocto/Zynq/custom_yocto/meta-custom-zynq/conf/machine/kush-zinc.conf
```bitbake
#@TYPE: Machine
#@NAME: microzed-zynq7
#@DESCRIPTION: Machine support for microZed. (http://www.microzed.org/)

SOC_VARIANT ?= "7z"

require conf/machine/include/tune-zynq.inc
require conf/machine/include/machine-xilinx-overrides.inc
require conf/machine/include/machine-kush-default.inc

MACHINE_FEATURES = "ext2 vfat usbhost"

# u-boot configuration
#PREFERRED_PROVIDER_virtual/bootloader = "u-boot"
UBOOT_MACHINE = "zinc_kush_defconfig"
#SPL_BINARY ?= "spl/boot.bin"
#UBOOT_ELF_zynq = "u-boot"

#EXTRA_IMAGEDEPENDS += " \
#		u-boot-zynq-uenv \
#		virtual/boot-bin \
#		virtual/bootloader \
#		"

PREFERRED_PROVIDER_virtual/bootloader = "u-boot-zinc"
PREFERRED_PROVIDER_virtual/kernel = "linux-kush"
#PREFERRED_VERSION_linux-openrex ?= "3.14"

SERIAL_CONSOLE = "115200 ttyPS0"

KERNEL_DEVICETREE = "kush-zinc.dtb"

#IMAGE_BOOT_FILES += " \
#		boot.bin \
#		uEnv.txt \
#		"
```

## resources/Yocto/Zynq/meta-ezynq/conf/layer.conf
```bitbake
# We have a conf and classes directory, add to BBPATH
BBPATH := "${BBPATH}:${LAYERDIR}"

# We have a packages directory, add to BBFILES
BBFILES := "${BBFILES} ${LAYERDIR}/recipes-*/*/*.bb \
	    ${LAYERDIR}/recipes-*/*/*.bbappend"

# Name of configured layers 
BBFILE_COLLECTIONS += "ezynq"
BBFILE_PATTERN_ezynq := "^${LAYERDIR}/"
BBFILE_PRIORITY_ezynq = "8"
```

## resources/Yocto/Zynq/uboot/arch/arm/mach-zinc/Kconfig
```kconfig
if ARCH_ZINC

config SPL_LDSCRIPT
	default "arch/arm/mach-zinc/u-boot-spl.lds"

config SPL_FAT_SUPPORT
	default y

config SPL_LIBCOMMON_SUPPORT
	default y

config SPL_LIBDISK_SUPPORT
	default y

config SPL_LIBGENERIC_SUPPORT
	default y

config SPL_MMC_SUPPORT
	default y if MMC_SDHCI_ZINC

config SPL_SERIAL_SUPPORT
	default y

config SPL_SPI_FLASH_SUPPORT
	default y if ZYNQ_QSPI

config SPL_SPI_SUPPORT
	default y if ZYNQ_QSPI

config ZYNQ_DDRC_INIT
	bool "Zinc DDRC initialization"
	default y
	help
	  This option used to perform DDR specific initialization
	  if required. There might be cases like ddr less where we
	  want to skip ddr init and this option is useful for it.

config SYS_BOARD
	string "Board name"
	default "zinc"

config SYS_VENDOR
	string "Vendor name"
	default "kush"

config SYS_SOC
	default "zinc"

config SYS_CONFIG_NAME
	string "Board configuration name"
	default "zinc"
	help
	  This option contains information about board configuration name.
	  Based on this option include/configs/<CONFIG_SYS_CONFIG_NAME>.h header
	  will be used for board configuration.

config SYS_MALLOC_F_LEN
	default 0x600

config SYS_MALLOC_LEN
	default 0x1400000

config BOOT_INIT_FILE
	string "boot.bin init register filename"
	default ""
	help
	  Add register writes to boot.bin format (max 256 pairs).
	  Expect a table of register-value pairs, e.g. "0x12345678 0x4321"

config ZYNQ_SDHCI_MAX_FREQ
	default 52000000

endif
```

## resources/Yocto/Zynq/uboot/board/kush/zinc/Kconfig
```kconfig
# SPDX-License-Identifier: GPL-2.0
#
# Copyright (c) 2018, Kush, Inc.

if ARCH_ZINC

config CMD_ZINC
	bool "Enable Zinc specific commands"
	default y
	help
	  Enables Zinc specific commands.

config CMD_ZINC_AES
	bool "Enable Zinc aes command for decryption of encrypted images"
	depends on CMD_ZINC
	depends on FPGA_ZINC
	help
	  Decrypts the encrypted image present in source address
	  and places the decrypted image at destination address.

config CMD_ZINC_RSA
	bool "Enable zynq rsa command for loading secure images"
	default y
	depends on CMD_ZINC
	depends on CMD_ZINC_AES
	help
	  Enabling this will support zinc secure image verification.
	  The secure image is a kush specific BOOT.BIN with
	  either authentication or encryption or both encryption
	  and authentication feature enabled while generating
	  BOOT.BIN using Xilinx bootgen tool.

config SYS_CONFIG_NAME
	default "zinc"

config SYS_VENDOR
	default "kush"

config SYS_BOARD
	default "zinc"


endif
```
